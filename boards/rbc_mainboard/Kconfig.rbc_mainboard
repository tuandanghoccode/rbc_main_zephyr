## boards/rbc_mainboard/Kconfig.rbc_mainboard
```kconfig
# SPDX-License-Identifier: Apache-2.0

config BOARD_RBC_MAINBOARD
        select SOC_STM32F407XG
```

## boards/rbc_mainboard/board.yml
```yaml
board:
  name: rbc_mainboard
  full_name: RBC2026 Mainboard
  vendor: custom
  socs:
    - name: stm32f407xx
```

## build/Kconfig/Kconfig.shield
```kconfig
osource "/home/tuangaooo/zephyrproject/rbc_main_zephyr/boards/shields/*/Kconfig.shield"
```

## build/Kconfig/Kconfig.shield.defconfig
```kconfig
osource "/home/tuangaooo/zephyrproject/rbc_r1/boards/shields/*/Kconfig.defconfig"
```

## build/Kconfig/arch/Kconfig.tmp
```kconfig
# Load Zephyr Arch Kconfig descriptions.
osource "/home/tuangaooo/zephyrproject/zephyr/arch/rx/Kconfig"
osource "/home/tuangaooo/zephyrproject/zephyr/arch/x86/Kconfig"
osource "/home/tuangaooo/zephyrproject/zephyr/arch/xtensa/Kconfig"
osource "/home/tuangaooo/zephyrproject/zephyr/arch/sparc/Kconfig"
osource "/home/tuangaooo/zephyrproject/zephyr/arch/riscv/Kconfig"
osource "/home/tuangaooo/zephyrproject/zephyr/arch/posix/Kconfig"
osource "/home/tuangaooo/zephyrproject/zephyr/arch/openrisc/Kconfig"
osource "/home/tuangaooo/zephyrproject/zephyr/arch/mips/Kconfig"
osource "/home/tuangaooo/zephyrproject/zephyr/arch/arm64/Kconfig"
osource "/home/tuangaooo/zephyrproject/zephyr/arch/arm/Kconfig"
osource "/home/tuangaooo/zephyrproject/zephyr/arch/arc/Kconfig"
```

## build/Kconfig/boards/Kconfig.defconfig
```kconfig
# Load Zephyr board defconfig descriptions.
osource "/home/tuangaooo/zephyrproject/rbc_r1/boards/rbc_mainboard/Kconfig.defconfig"
```

## build/Kconfig/boards/Kconfig.defconfig.tmp
```kconfig
# Load Zephyr board defconfig descriptions.
osource "/home/tuangaooo/zephyrproject/rbc_main_zephyr/boards/rbc_mainboard/Kconfig.defconfig"
```

## build/Kconfig/boards/Kconfig.rbc_mainboard
```kconfig
# Load board Kconfig descriptions.
osource "/home/tuangaooo/zephyrproject/rbc_main_zephyr/boards/rbc_mainboard/Kconfig.rbc_mainboard"
```

## build/Kconfig/boards/Kconfig.sysbuild
```kconfig
# Load Sysbuild board Kconfig descriptions.
osource "/home/tuangaooo/zephyrproject/rbc_main_zephyr/boards/rbc_mainboard/Kconfig.sysbuild"
```
